## build/openembedded/conf/layer.conf
```bitbake
# We have a conf and classes directory, append to BBPATH
BBPATH .= ":${LAYERDIR}"

# We have a recipes directory, add to BBFILES
BBFILES += "${LAYERDIR}/*.bb ${LAYERDIR}/*/*.bb"

BBFILE_COLLECTIONS += "linphone-layer"
BBFILE_PATTERN_linphone-layer := "^${LAYERDIR}/"
BBFILE_PRIORITY_linphone-layer = "50"
```
